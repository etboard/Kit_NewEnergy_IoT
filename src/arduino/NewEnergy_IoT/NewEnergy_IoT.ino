/******************************************************************************************
 * FileName     : NewEnergy_IoT
 * Description  : 이티보드 스마트 신재생 에너지 코딩 키트(IoT)
 * Author       : SCS
 * Created Date : 2022.08.18
 * Reference    : 
 * Modified     : 2022.08.19 : LSC
 * Modified     : 2022.12.28 : YSY : 변수 명명법 통일
******************************************************************************************/
const char* board_hardware_verion = "ETBoard_V1.1";
const char* board_firmware_verion = "smartNey_0.91";

//==========================================================================================
// 응용 프로그램 구성 사용하기                       
//==========================================================================================
#include "app_config.h"
APP_CONFIG app;

//==========================================================================================
// 상수 정의                                       
//==========================================================================================
// 메시지 송신 주기 : 주의!!!! 너무 빨리 또는 많이 보내면 서버에서 거부할 수 있음(Banned)
//------------------------------------------------------------------------------------------
#define NORMAL_SEND_INTERVAL  (1000 * 5)          // 권장 5초 (단위: 초/1000)


//==========================================================================================
// ETBoard 핀번호 설정                                  
//==========================================================================================
const int solar_pin = A3;                         // 태양광 발전량 측정 센서
const int wind_pin  = A5;                         // 풍력 발전량 측정 센서

float solar_power;                                // 태양광 발전기 값(V)
float wind_power;                                 // 풍력 발전기 값(V)

const double c_Value = 0.000806;                  // 전압 보정 변수 선언 (3.3v / 4096)

float Solar_Max = 0;                              // 태양광 발전기 최대값 
float Wind_Max  = 0;                              // 풍력 발전기 최대값


//==========================================================================================
void setup()                                      // 설정 함수 
//==========================================================================================
// (권장 사항) 이 함수에서는 코딩하지 마십시오. custom_setup()에 코딩하십시오.
//------------------------------------------------------------------------------------------
{
    app.setup();                                  // 응용 프로그램 기본 설정
    
    custom_setup();                               // 사용자 맞춤형 설정
}


//==========================================================================================
void custom_setup()                               // 사용자 맞춤형 설정 함수
//==========================================================================================
{
    //--------------------------------------------------------------------------------------
    // 여기에 사용자 맞춤형 설정을 코딩하세요.
    //--------------------------------------------------------------------------------------
}


//==========================================================================================
void loop()                                       // 반복 루틴
//==========================================================================================
//  (권장 사항) 이 함수를 가능하면 수정하지 마십시오 !!! 
//  do_sensing_process(), do_automatic_process(), send_sensor_value(), 
//------------------------------------------------------------------------------------------
{
    //--------------------------------------------------------------------------------------
    // MQTT 백그라운드 동작 
    //--------------------------------------------------------------------------------------
    app.mqtt.loop();

    //--------------------------------------------------------------------------------------
    // 센싱 처리
    //--------------------------------------------------------------------------------------       
    do_sensing_process();                             

    //--------------------------------------------------------------------------------------
    // 동작 모드가 automatic 일 경우 자동화 처리
    //--------------------------------------------------------------------------------------      
    if(app.operation_mode == "automatic") {       // 수정 금지
        do_automatic_process();                   // 자동화 처리    
    }
    
    //--------------------------------------------------------------------------------------
    // 주기적으로 메시지 전송 처리
    //--------------------------------------------------------------------------------------
    if (millis() - app.lastMillis > NORMAL_SEND_INTERVAL) {  
        send_sensor_value();                      // 센서 값 송신
        app.lastMillis = millis();                // 현재 시각 업데이트
    }

    //--------------------------------------------------------------------------------------
    // 동작 상태 LED 깜밖이기
    //--------------------------------------------------------------------------------------  
    app.etboard.normal_blink_led();               
}


//==========================================================================================
void do_sensing_process()                         // 센싱 처리 함수
//==========================================================================================
{ 
    //--------------------------------------------------------------------------------------
    // 태양광 센서 센싱하기
    //--------------------------------------------------------------------------------------  
    solar_power = analogRead(solar_pin);          // 태양광 센서 읽기
    if(solar_power > Solar_Max)             
        Solar_Max = solar_power;
  
    //--------------------------------------------------------------------------------------
    // 모터 발전기 센싱하기
    //--------------------------------------------------------------------------------------  
    wind_power = analogRead(wind_pin);            // 모터 발전기 읽기
    if(wind_power > Wind_Max)
        Wind_Max = wind_power;
}


//==========================================================================================
void do_automatic_process()                       // 자동화 처리 함수
//==========================================================================================
// 여기에 자동화 처리를 코딩하세요.
//------------------------------------------------------------------------------------------
{  
    //--------------------------------------------------------------------------------------  
    // 신재생 에너지 모듈 OLED 제어
    //--------------------------------------------------------------------------------------  
    char text1[32] = "Solar: ";
    char value1[32];   
    String str1 = String(solar_power*c_Value, DEC);
    str1.toCharArray(value1,6);
    strcat(text1,value1);
    strcat(text1," V");

    char text2[32] = "Wind: ";
    char value2[32];    
    String str2 = String(wind_power*c_Value, DEC);
    str2.toCharArray(value2,6);
    strcat(text2,value2);
    strcat(text2," V");

    delay(10);
    app.oled.setLine(1,"* ECO Energy *");         // OLED 첫 번째 줄 : 시스템 이름
    app.oled.setLine(2,text1);                    // OLED 두 번째 줄 : 태양광 발전량
    app.oled.setLine(3,text2);                    // OLED 세 번째 줄 : 풍력 발전량
    app.oled.display();
}


//==========================================================================================
void send_sensor_value()                          // 센서 값 송신 함수
//==========================================================================================
{ 
    // 예시 {"Solar":1.08,"Windturbine":0.53, "Solar_Max":2.14, "Wind_Max":0.98}
    DynamicJsonDocument doc(256);                                  // json 
    doc["Solar"] = app.etboard.round2(solar_power*c_Value);        // 거리 값 송신, 소수점 2자리
    doc["Windturbine"] = app.etboard.round2(wind_power*c_Value);   // 조도 값 송신
    doc["Solar_Max"] = app.etboard.round2(Solar_Max*c_Value);
    doc["Wind_Max"] = app.etboard.round2(Wind_Max*c_Value);

    String output;                                                 // 문자열 변수
    serializeJson(doc, output);                                    // json을 문자열로 변환
    app.mqtt.publish_tele("/sensor", output);                      // 송신
}


//==========================================================================================
void onConnectionEstablished()                    // MQTT 연결되었을 때 동작하는 함수
//==========================================================================================
{
    app.mqtt.onConnectionEstablished();           // MQTT 연결되었을 때 동작
}

//==========================================================================================
//                                                    
// (주)한국공학기술연구원 http://et.ketri.re.kr       
//                                                    
//==========================================================================================
